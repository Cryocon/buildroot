## configs/m18i_defconfig
```kconfig
BR2_arm=y
BR2_DL_DIR="~/buildroot_dl"
BR2_HOST_DIR="$(TOPDIR)/output-host"
BR2_BACKUP_SITE="http://sources.buildroot.net/"
BR2_KERNEL_MIRROR="http://www.kernel.org/pub/"
BR2_LUAROCKS_MIRROR="http://luarocks.org/repositories/rocks"
BR2_CPAN_MIRROR="http://search.cpan.org/CPAN"
BR2_JLEVEL=5
BR2_CCACHE=y
BR2_ENABLE_DEBUG=y
BR2_DEBUG_3=y
BR2_OPTIMIZE_2=y
BR2_SHARED_STATIC_LIBS=y
BR2_PACKAGE_OVERRIDE_FILE="$(TOPDIR)/local.mk"
BR2_GLOBAL_PATCH_DIR="board/cryocon/common"
BR2_TOOLCHAIN_BUILDROOT_GLIBC=y
BR2_KERNEL_HEADERS_VERSION=y
BR2_DEFAULT_KERNEL_VERSION="4.9.5"
BR2_GLIBC_VERSION_2_22=y
BR2_BINUTILS_VERSION_2_25_X=y
BR2_GCC_VERSION_4_9_X=y
BR2_TOOLCHAIN_BUILDROOT_CXX=y
BR2_GCC_ENABLE_LTO=y
BR2_GCC_ENABLE_GRAPHITE=y
BR2_PACKAGE_HOST_GDB=y
BR2_PACKAGE_HOST_GDB_TUI=y
BR2_PACKAGE_HOST_GDB_PYTHON=y
BR2_GDB_VERSION_7_11=y
BR2_TARGET_OPTIMIZATION="-Os -pipe"
BR2_TARGET_GENERIC_HOSTNAME="m18i"
BR2_ROOTFS_DEVICE_CREATION_DYNAMIC_EUDEV=y
BR2_ROOTFS_DEVICE_TABLE="board/cryocon/common/device_table.txt"
BR2_TARGET_GENERIC_GETTY_PORT="ttyS0"
BR2_TARGET_GENERIC_GETTY_BAUDRATE_115200=y
# BR2_TARGET_GENERIC_REMOUNT_ROOTFS_RW is not set
BR2_ENABLE_LOCALE_WHITELIST="en_US en_US.UTF-8"
BR2_GENERATE_LOCALE="en_US.UTF-8"
BR2_ROOTFS_USERS_TABLES="board/cryocon/common/users_table.txt"
BR2_ROOTFS_OVERLAY="board/cryocon/common/rootfs_overlay"
BR2_ROOTFS_POST_BUILD_SCRIPT="board/cryocon/common/post-build.sh"
BR2_PACKAGE_BUSYBOX_SHOW_OTHERS=y
BR2_PACKAGE_BUSYBOX_WATCHDOG=y
BR2_PACKAGE_BUSYBOX_WATCHDOG_PERIOD="100ms"
BR2_PACKAGE_GDB=y
BR2_PACKAGE_LSOF=y
BR2_PACKAGE_LTRACE=y
BR2_PACKAGE_OPROFILE=y
BR2_PACKAGE_RT_TESTS=y
BR2_PACKAGE_STRACE=y
BR2_PACKAGE_STRESS=y
BR2_PACKAGE_BINUTILS_TARGET=y
BR2_PACKAGE_DOSFSTOOLS=y
BR2_PACKAGE_DOSFSTOOLS_FSCK_FAT=y
BR2_PACKAGE_DOSFSTOOLS_MKFS_FAT=y
BR2_PACKAGE_E2FSPROGS=y
BR2_PACKAGE_MTD=y
BR2_PACKAGE_DBUS=y
BR2_PACKAGE_EPICS_BASE=y
BR2_PACKAGE_EVTEST=y
BR2_PACKAGE_I2C_TOOLS=y
BR2_PACKAGE_MEMTESTER=y
BR2_PACKAGE_SETSERIAL=y
BR2_PACKAGE_USBMOUNT=y
BR2_PACKAGE_USBUTILS=y
BR2_PACKAGE_PYTHON=y
BR2_PACKAGE_PYTHON_PY_PYC=y
BR2_PACKAGE_PYTHON_BZIP2=y
BR2_PACKAGE_PYTHON_SSL=y
BR2_PACKAGE_PYTHON_HASHLIB=y
BR2_PACKAGE_PYTHON_FLASK_SOCKETS=y
BR2_PACKAGE_PYTHON_FLUP=y
BR2_PACKAGE_PYTHON_GUNICORN=y
BR2_PACKAGE_PYTHON_IPYTHON=y
BR2_PACKAGE_PYTHON_IPYTHON_NOTEBOOK=y
BR2_PACKAGE_PYTHON_SPITFIRE=y
BR2_PACKAGE_LIBMHASH=y
BR2_PACKAGE_OPENSSL_BIN=y
BR2_PACKAGE_SQLITE=y
BR2_PACKAGE_DTC=y
BR2_PACKAGE_DTC_PROGRAMS=y
BR2_PACKAGE_CZMQ=y
BR2_PACKAGE_LIBMODBUS=y
BR2_PACKAGE_LIBNETFILTER_CONNTRACK=y
BR2_PACKAGE_NANOMSG=y
BR2_PACKAGE_NSS_MDNS=y
BR2_PACKAGE_LIBEVDEV=y
BR2_PACKAGE_PROTOBUF=y
BR2_PACKAGE_PROTOBUF_C=y
BR2_PACKAGE_READLINE=y
BR2_PACKAGE_HEIRLOOM_MAILX=y
BR2_PACKAGE_AVAHI=y
# BR2_PACKAGE_AVAHI_AUTOIPD is not set
BR2_PACKAGE_AVAHI_DAEMON=y
BR2_PACKAGE_BIND=y
# BR2_PACKAGE_BIND_SERVER is not set
BR2_PACKAGE_BIND_TOOLS=y
BR2_PACKAGE_ETHTOOL=y
BR2_PACKAGE_IPROUTE2=y
BR2_PACKAGE_IPTABLES=y
BR2_PACKAGE_LIGHTTPD=y
BR2_PACKAGE_LIGHTTPD_OPENSSL=y
BR2_PACKAGE_LIGHTTPD_PCRE=y
BR2_PACKAGE_LRZSZ=y
BR2_PACKAGE_MII_DIAG=y
BR2_PACKAGE_NETCAT_OPENBSD=y
BR2_PACKAGE_NTP=y
BR2_PACKAGE_NTP_SNTP=y
BR2_PACKAGE_NTP_NTPDATE=y
BR2_PACKAGE_NTP_TICKADJ=y
BR2_PACKAGE_OPENSSH=y
BR2_PACKAGE_PORTMAP=y
BR2_PACKAGE_SOCAT=y
BR2_PACKAGE_SPAWN_FCGI=y
BR2_PACKAGE_GNUPG=y
BR2_PACKAGE_GNUPG_RSA=y
BR2_PACKAGE_GNUPG_GPGV=y
BR2_PACKAGE_LOGROTATE=y
BR2_PACKAGE_SCREEN=y
BR2_PACKAGE_KMOD_TOOLS=y
BR2_PACKAGE_PSMISC=y
BR2_PACKAGE_TAR=y
BR2_PACKAGE_NANO=y
BR2_TARGET_UBOOT=y
BR2_TARGET_UBOOT_BOARDNAME="at91sam9x5ek_nandflash"
```

## configs/m54_defconfig
```kconfig
BR2_arm=y
BR2_DL_DIR="~/buildroot_dl"
BR2_BACKUP_SITE="http://sources.buildroot.net/"
BR2_KERNEL_MIRROR="http://www.kernel.org/pub/"
BR2_LUAROCKS_MIRROR="http://luarocks.org/repositories/rocks"
BR2_CPAN_MIRROR="http://search.cpan.org/CPAN"
BR2_JLEVEL=5
BR2_CCACHE=y
BR2_ENABLE_DEBUG=y
BR2_DEBUG_3=y
BR2_PACKAGE_OVERRIDE_FILE="$(TOPDIR)/local.mk"
BR2_GLOBAL_PATCH_DIR="board/cryocon/common board/cryocon/m54"
BR2_TOOLCHAIN_BUILDROOT_GLIBC=y
BR2_KERNEL_HEADERS_VERSION=y
BR2_DEFAULT_KERNEL_VERSION="4.9.5"
BR2_GLIBC_VERSION_2_22=y
BR2_BINUTILS_VERSION_2_25_X=y
BR2_GCC_VERSION_4_9_X=y
BR2_TOOLCHAIN_BUILDROOT_CXX=y
BR2_GCC_ENABLE_GRAPHITE=y
BR2_PACKAGE_HOST_GDB=y
BR2_PACKAGE_HOST_GDB_TUI=y
BR2_PACKAGE_HOST_GDB_PYTHON=y
BR2_TARGET_OPTIMIZATION="-Os -pipe"
BR2_TARGET_GENERIC_HOSTNAME="m54"
BR2_ROOTFS_DEVICE_CREATION_DYNAMIC_EUDEV=y
BR2_ROOTFS_DEVICE_TABLE="board/cryocon/common/device_table.txt"
BR2_TARGET_GENERIC_GETTY_PORT="ttyS0"
BR2_TARGET_GENERIC_GETTY_BAUDRATE_115200=y
# BR2_TARGET_GENERIC_REMOUNT_ROOTFS_RW is not set
BR2_ENABLE_LOCALE_WHITELIST="en_US en_US.UTF-8"
BR2_GENERATE_LOCALE="en_US.UTF-8"
BR2_ROOTFS_USERS_TABLES="board/cryocon/common/users_table.txt"
BR2_ROOTFS_OVERLAY="board/cryocon/common/rootfs_overlay board/cryocon/m54/rootfs_overlay"
BR2_ROOTFS_POST_BUILD_SCRIPT="board/cryocon/common/post-build.sh"
BR2_PACKAGE_BUSYBOX_SHOW_OTHERS=y
BR2_PACKAGE_BUSYBOX_WATCHDOG=y
BR2_PACKAGE_BUSYBOX_WATCHDOG_PERIOD="100ms"
BR2_PACKAGE_GDB=y
BR2_PACKAGE_LSOF=y
BR2_PACKAGE_LTRACE=y
BR2_PACKAGE_OPROFILE=y
BR2_PACKAGE_RT_TESTS=y
BR2_PACKAGE_STRACE=y
BR2_PACKAGE_STRESS=y
BR2_PACKAGE_BINUTILS_TARGET=y
BR2_PACKAGE_DOSFSTOOLS=y
BR2_PACKAGE_DOSFSTOOLS_FSCK_FAT=y
BR2_PACKAGE_DOSFSTOOLS_MKFS_FAT=y
BR2_PACKAGE_E2FSPROGS=y
BR2_PACKAGE_MTD=y
BR2_PACKAGE_MTD_MKFSJFFS2=y
BR2_PACKAGE_PSPLASH=y
BR2_PACKAGE_XORG7=y
BR2_PACKAGE_XSERVER_XORG_SERVER=y
BR2_PACKAGE_XLIB_LIBXCOMPOSITE=y
BR2_PACKAGE_XAPP_SHOWFONT=y
BR2_PACKAGE_XAPP_X11PERF=y
BR2_PACKAGE_XAPP_XAUTH=y
BR2_PACKAGE_XAPP_XDPYINFO=y
BR2_PACKAGE_XAPP_XINPUT=y
BR2_PACKAGE_XAPP_XINPUT_CALIBRATOR=y
BR2_PACKAGE_XAPP_XRANDR=y
BR2_PACKAGE_XAPP_XWD=y
BR2_PACKAGE_XAPP_XWININFO=y
BR2_PACKAGE_XDRIVER_XF86_INPUT_EVDEV=y
BR2_PACKAGE_XDRIVER_XF86_INPUT_MOUSE=y
BR2_PACKAGE_XDRIVER_XF86_VIDEO_FBDEV=y
BR2_PACKAGE_XPROTO_DRI2PROTO=y
BR2_PACKAGE_XPROTO_DRI3PROTO=y
BR2_PACKAGE_XPROTO_XF86DRIPROTO=y
BR2_PACKAGE_DBUS=y
BR2_PACKAGE_EVTEST=y
BR2_PACKAGE_I2C_TOOLS=y
BR2_PACKAGE_MEMTESTER=y
BR2_PACKAGE_SETSERIAL=y
BR2_PACKAGE_USBMOUNT=y
BR2_PACKAGE_USBUTILS=y
BR2_PACKAGE_PYTHON=y
BR2_PACKAGE_PYTHON_PY_PYC=y
BR2_PACKAGE_PYTHON_BZIP2=y
BR2_PACKAGE_PYTHON_SSL=y
BR2_PACKAGE_PYTHON_FLASK_SOCKETS=y
BR2_PACKAGE_PYTHON_FLUP=y
BR2_PACKAGE_PYTHON_GUNICORN=y
BR2_PACKAGE_PYTHON_IPYTHON=y
BR2_PACKAGE_PYTHON_IPYTHON_NOTEBOOK=y
BR2_PACKAGE_PYTHON_SERIAL=y
BR2_PACKAGE_PYTHON_SPITFIRE=y
BR2_PACKAGE_LIBMHASH=y
BR2_PACKAGE_OPENSSL_BIN=y
BR2_PACKAGE_SQLITE=y
BR2_PACKAGE_FLTK=y
BR2_PACKAGE_FLEK=y
BR2_PACKAGE_DTC=y
BR2_PACKAGE_DTC_PROGRAMS=y
BR2_PACKAGE_LIBINPUT=y
BR2_PACKAGE_LIBXKBCOMMON=y
BR2_PACKAGE_CZMQ=y
BR2_PACKAGE_LIBMODBUS=y
BR2_PACKAGE_LIBNETFILTER_CONNTRACK=y
BR2_PACKAGE_NANOMSG=y
BR2_PACKAGE_NSS_MDNS=y
BR2_PACKAGE_PROTOBUF=y
BR2_PACKAGE_PROTOBUF_C=y
BR2_PACKAGE_READLINE=y
BR2_PACKAGE_HEIRLOOM_MAILX=y
BR2_PACKAGE_GOOGLEFONTDIRECTORY=y
BR2_PACKAGE_AVAHI=y
# BR2_PACKAGE_AVAHI_AUTOIPD is not set
BR2_PACKAGE_AVAHI_DAEMON=y
BR2_PACKAGE_BIND=y
# BR2_PACKAGE_BIND_SERVER is not set
BR2_PACKAGE_BIND_TOOLS=y
BR2_PACKAGE_ETHTOOL=y
BR2_PACKAGE_IPROUTE2=y
BR2_PACKAGE_IPTABLES=y
BR2_PACKAGE_LIGHTTPD=y
BR2_PACKAGE_LIGHTTPD_OPENSSL=y
BR2_PACKAGE_LIGHTTPD_PCRE=y
BR2_PACKAGE_LRZSZ=y
BR2_PACKAGE_MII_DIAG=y
BR2_PACKAGE_NETCAT_OPENBSD=y
BR2_PACKAGE_NTP=y
BR2_PACKAGE_NTP_SNTP=y
BR2_PACKAGE_NTP_NTPDATE=y
BR2_PACKAGE_NTP_TICKADJ=y
BR2_PACKAGE_OPENSSH=y
BR2_PACKAGE_PORTMAP=y
BR2_PACKAGE_SOCAT=y
BR2_PACKAGE_SPAWN_FCGI=y
BR2_PACKAGE_GNUPG=y
BR2_PACKAGE_GNUPG_RSA=y
BR2_PACKAGE_GNUPG_GPGV=y
BR2_PACKAGE_LOGROTATE=y
BR2_PACKAGE_SCREEN=y
BR2_PACKAGE_KMOD_TOOLS=y
BR2_PACKAGE_PSMISC=y
BR2_PACKAGE_TAR=y
BR2_PACKAGE_NANO=y
BR2_TARGET_UBOOT=y
BR2_TARGET_UBOOT_BOARDNAME="at91sam9x5ek_nandflash"
BR2_PACKAGE_HOST_E2FSPROGS=y
BR2_PACKAGE_HOST_GENEXT2FS=y
BR2_PACKAGE_HOST_SAM_BA=y
```

## package/efl18/Config.in
```kconfig
menuconfig BR2_PACKAGE_EFL18
	bool "Enlightenment Foundation Libraries (new packaging)"
	depends on BR2_USE_WCHAR
	# libeina, libeo, libescape use madvise().
	depends on BR2_USE_MMU
	select BR2_PACKAGE_LIBEDJE18
	select BR2_PACUAGE_DBUS
	help
	  Enlightenment Foundation Libraries

	  http://enlightenment.org

if BR2_PACKAGE_EFL18

comment "libedje needs a toolchain w/ threads"
	depends on !BR2_avr32
	depends on !BR2_TOOLCHAIN_HAS_THREADS

config BR2_PACKAGE_LIBEDJE18
	bool "libedje18"
#	select BR2_PACKAGE_LIBEINA
#	select BR2_PACKAGE_LIBEET
#	select BR2_PACKAGE_LIBECORE
#	select BR2_PACKAGE_LIBECORE_EVAS
#	select BR2_PACKAGE_LIBEMBRYO
#	select BR2_PACKAGE_LIBEVAS
#	select BR2_PACKAGE_LUA
	select BR2_PACKAGE_LUAJIT
	depends on !BR2_avr32 # libevas
	depends on BR2_TOOLCHAIN_HAS_THREADS # libevas
	help
	  A graphical layout and animation library for animated
	  resizable, compressed and scalable themes.

	  http://trac.enlightenment.org/e/wiki/Edje #TODO: Updated web address

if BR2_PACKAGE_LIBEDJE18

config BR2_PACKAGE_LIBEDJE18_CC
	bool "build edje18_cc"
	help
	  Build and install the Edje compiler for the target. Normally this
	  is not required.

endif

source "package/efl18/libelementary18/Config.in"

endif # BR2_PACKAGE_EFL18

comment "EFL needs a toolchain w/ wchar"
	depends on !BR2_USE_WCHAR
```

## package/efl18/libelementary18/Config.in
```kconfig
comment "libelementary needs a toolchain w/ threads"
	depends on !BR2_avr32
	depends on !BR2_TOOLCHAIN_HAS_THREADS

config BR2_PACKAGE_LIBELEMENTARY18
	bool "libelementary18"
	depends on !BR2_avr32 # libevas
	depends on BR2_TOOLCHAIN_HAS_THREADS # libevas
	help
	  Elementary is a widget toolkit and EFL wrapper and convenience
	  library to make it easy to build applications and tools with UIs
	  with less code.

	  http://trac.enlightenment.org/e/wiki/Elementary #TODO
```

## package/epics-base/Config.in
```kconfig
config BR2_PACKAGE_EPICS_BASE
	bool "epics-base"
	depends on BR2_INSTALL_LIBSTDCPP
	select BR2_PACKAGE_READLINE
	help

comment "epics-base needs a toolchain w/ C++"
	depends on !BR2_INSTALL_LIBSTDCPP
```

## package/mosh/Config.in
```kconfig
config BR2_PACKAGE_MOSH
	bool "mosh"
	select BR2_PACKAGE_NCURSES
	select BR2_PACKAGE_ZLIB
	select BR2_PACKAGE_PROTOBUF
	select BR2_PACKAGE_OPENSSL
```

## package/protobuf-c/Config.in
```kconfig
config BR2_PACKAGE_PROTOBUF_C
	bool "protobuf-c"
	depends on BR2_PACKAGE_PROTOBUF
	help
```

## package/python-additional/Config.in
```kconfig
config BR2_PACKAGE_PYTHON_ADDITIONAL
	bool "python-additional"
	depends on BR2_PACKAGE_PYTHON
	help
	  Fetch additional packages using pip (which are too obscure to be
	  supported directly in Buildroot or have installation problems) 
	select BR2_PACKAGE_PYTHON_FLASK
	select BR2_PACKAGE_PYTHON_GEVENT
	select BR2_PACKAGE_PYTHON_GUNICORN
	select BR2_PACKAGE_PYTHON_SETUPTOOLS

config BR2_PACKAGE_PYTHON_ADDITIONAL_PACKAGES
	string "python-additional-packages"
	depends on BR2_PACKAGE_PYTHON_ADDITIONAL
	help
	  Space-separated list of Python packages (or requirements) to pip install.
```

## package/python-flask-sockets/Config.in
```kconfig
config BR2_PACKAGE_PYTHON_FLASK_SOCKETS
	bool "python-flask-sockets"
	select BR2_PACKAGE_PYTHON_FLASK # runtime
	select BR2_PACKAGE_PYTHON_GEVENT # runtime
	select BR2_PACKAGE_PYTHON_GEVENT_WEBSOCKET # runtime
	help
	  Elegant WebSockets for your Flask apps.

	  https://github.com/kennethreitz/flask-sockets
```

## package/python-flask/Config.in
```kconfig
config BR2_PACKAGE_PYTHON_FLASK
	bool "python-flask"
	select BR2_PACKAGE_PYTHON_WERKZEUG # runtime
	select BR2_PACKAGE_PYTHON_JINJA2 # runtime
	select BR2_PACKAGE_PYTHON_ITSDANGEROUS # runtime
	select BR2_PACKAGE_PYTHON_CLICK # runtime
	help
	  A microframework based on Werkzeug, Jinja2 and good intentions.

	  http://github.com/pallets/flask/
```

## package/python-gevent-websocket/Config.in
```kconfig
config BR2_PACKAGE_PYTHON_GEVENT_WEBSOCKET
	bool "python-gevent-websocket"
	select BR2_PACKAGE_PYTHON_GEVENT # runtime
	help
	  Websocket handler for the gevent pywsgi server, a Python network
	  library.

	  https://bitbucket.org/Jeffrey/gevent-websocket
```

## package/python-gevent/Config.in
```kconfig
config BR2_PACKAGE_PYTHON_GEVENT
	bool "python-gevent"
	select BR2_PACKAGE_LIBEV
	select BR2_PACKAGE_PYTHON_GREENLET # runtime
	select BR2_PACKAGE_PYTHON_SETUPTOOLS # runtime
	help
	  Coroutine-based network library.

	  http://www.gevent.org/
```

## package/python-greenlet/Config.in
```kconfig
config BR2_PACKAGE_PYTHON_GREENLET
	bool "python-greenlet"
	depends on BR2_PACKAGE_PYTHON
```

## package/python-gunicorn/Config.in
```kconfig
config BR2_PACKAGE_PYTHON_GUNICORN
	bool "python-gunicorn"
	depends on BR2_PACKAGE_PYTHON
	select BR2_PACKAGE_PYTHON_GEVENT
	select BR2_PACKAGE_PYTHON_LIBEV
	select BR2_PACKAGE_PYTHON_GREENLET
```

## package/python-ipython/Config.in
```kconfig
config BR2_PACKAGE_PYTHON_IPYTHON
	bool "python-ipython"
	help
	  IPython is a command shell for interactive computing in multiple
	  programming languages, originally developed for the Python
	  programming language, that offers enhanced introspection, rich
	  media, additional shell syntax, tab completion, and rich history.

	  http://ipython.org/

if BR2_PACKAGE_PYTHON_IPYTHON
    config BR2_PACKAGE_PYTHON_IPYTHON_NOTEBOOK
	    bool "IPython Notebook"
	    select BR2_PACKAGE_PYTHON_PYZMQ
	    select BR2_PACKAGE_PYTHON_TORNADO
	    select BR2_PACKAGE_PYTHON_JINJA2
endif
```

## package/python-spitfire/Config.in
```kconfig
config BR2_PACKAGE_PYTHON_SPITFIRE
	bool "python-spitfire"
	depends on BR2_PACKAGE_PYTHON
	help
	  Spitfire is a template language heavily inspired by Cheetah.

	  http://code.google.com/p/spitfire
```

## package/python-tornado/Config.in
```kconfig
config BR2_PACKAGE_PYTHON_TORNADO
	bool "python-tornado"
	depends on BR2_PACKAGE_PYTHON
```

## package/x11r7/xcb-util-render/Config.in
```kconfig
config BR2_PACKAGE_XCB_UTIL_RENDER
	bool "xcb-util-render"
	depends on BR2_PACKAGE_LIBXCB
	help
	  http://xcb.freedesktop.org/
```
